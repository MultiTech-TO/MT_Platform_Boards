## boards/Multitech/SWT_043A_01/Kconfig.defconfig
```kconfig
# Copyright (c) 2020 Piotr Mienkowski
# Copyright (c) 2020 TriaGnoSys GmbH
# Copyright (c) 2025 Silicon Laboratories Inc.
# SPDX-License-Identifier: Apache-2.0

if BOARD_SWT_043A_01

config FPU
	default y if SOC_GECKO_USE_RAIL || BT

if BT

config MAIN_STACK_SIZE
	default 3072 if PM
	default 2304

endif # BT

endif

config BOARD_SWT_043A_01
	select SOC_EFR32BG24A020F1024IM40
```

## boards/Multitech/SWT_043A_01/board.yml
```yaml
boards:
  - name: swt_043a_01
    full_name: Multitech Platform Development Board (SWT-043A-01)
    vendor: multitech
    socs:
      - name: efr32bg24a020f1024im40
```

## boards/Multitech/Template/board.yml
```yaml
boards:
  - name: template
    full_name: template
    vendor: multitech
    socs:
      - name: efr32bg24a020f1024im40
```
